/*
 * Accton AS4610 54 Device Tree Source
 *
 * Copyright 2015, Cumulus Networks, Inc.
 *
 * This program is free software; you can redistribute  it and/or modify it
 * under  the terms of  the GNU General  Public License as published by the
 * Free Software Foundation;  either version 2 of the  License, or (at your
 * option) any later version.
 *
 */
/dts-v1/;
#include "arm-accton-as4610.dtsi"

/ {
    model = "accton,as4610_54";
    compatible = "accton,as4610_54","brcm,helix4";
};
