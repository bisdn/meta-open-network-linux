## conf/layer.conf
```bitbake
# We have a conf and classes directory, add to BBPATH
BBPATH .= ":${LAYERDIR}"

# We have recipes-* directories, add to BBFILES
BBFILES += "${LAYERDIR}/recipes-*/*/*.bb \
	${LAYERDIR}/recipes-*/*/*.bbappend"

BBFILE_COLLECTIONS += "open-network-linux"
BBFILE_PATTERN_open-network-linux = "^${LAYERDIR}/"
BBFILE_PRIORITY_open-network-linux = "6"

LAYERSERIES_COMPAT_open-network-linux = "dunfell"
```

## conf/machine/accton-as4610.conf
```bitbake
#@TYPE: Machine
#@NAME: accton-as4610-30

#@DESCRIPTION: Machine configuration for accton-as4610-30 systems

PREFERRED_PROVIDER_virtual/kernel ?= "linux-yocto-onl"
PREFERRED_VERSION_linux-yocto-onl ?= "6.1%"

KMACHINE:accton-as4610 = "armel-iproc"
KERNEL_FEATURES += "bsp/armel-iproc"

DEFAULTTUNE ?= "cortexa9"
require conf/machine/include/qemu.inc
require conf/machine/include/arm/armv7a/tune-cortexa9.inc
require conf/machine/include/onl.inc

MACHINE_FEATURES += "pcbios"
MACHINE_FEATURES:remove = "alsa"

KERNEL_FEATURES:remove = "features/debug/printk.scc features/kernel-sample/kernel-sample.scc"

# https://git.yoctoproject.org/poky/tree/meta/classes/kernel-fitimage.bbclass
KERNEL_CLASSES += "kernel-fitimage"

KERNEL_IMAGETYPE = "fitImage"
UBOOT_ENTRYPOINT="0x61008000"
UBOOT_RD_LOADADDRESS = "0x00000000"
UBOOT_RD_ENTRYPOINT = "0x00000000"
# AS4610 U-Boot does not support sha256
FIT_HASH_ALG = "sha1"
KERNEL_EXTRA_ARGS += "LOADADDR=${UBOOT_ENTRYPOINT}"
KERNEL_DEVICETREE = "arm-accton-as4610.dtb arm-accton-as4610-30t.dtb arm-accton-as4610-30p.dtb arm-accton-as4610-54t.dtb arm-accton-as4610-54p.dtb"
BISDN_ARCH = "u-boot-arch"

ONIE_VENDOR = "accton"
ONIE_MACHINE_TYPE = "as4610_30"

ONL_PLATFORM_SUPPORT = " \
    arm-accton_as4610_30-r0 \
    arm-accton_as4610_54-r0 \
"

MACHINE_EXTRA_RDEPENDS += " \
    accton-as4610-poe-mcu-mod \
    kernel-module-accton-as4610-cpld \
    kernel-module-accton-as4610-fan \
    kernel-module-accton-as4610-leds \
    kernel-module-accton-as4610-psu \
    kernel-module-optoe \
    kernel-module-ym2651y \
    platform-onl-init \
"

UBOOT_CONFIG = "sandbox"
UBOOT_CONFIG[sandbox] = "sandbox_defconfig"

PREFERRED_RPROVIDER_u-boot-default-env = "platform-onl-init"
```

## conf/machine/accton-as4630-54pe.conf
```bitbake
#@TYPE: Machine
#@NAME: accton-as4630-54pe

#@DESCRIPTION: Machine configuration for accton-as4630-54pe systems

PREFERRED_PROVIDER_virtual/kernel ?= "linux-yocto-onl"
PREFERRED_VERSION_linux-yocto-onl ?= "5.15%"

KMACHINE:accton-as4630-54pe = "x86_64-intel"
KERNEL_FEATURES += "bsp/x86_64-intel"

DEFAULTTUNE ?= "corei7-64"

require conf/machine/include/x86/tune-corei7.inc
require conf/machine/include/x86/x86-base.inc
require conf/machine/include/onl.inc

MACHINE_FEATURES += "pcbios efi"
MACHINE_FEATURES:remove = "alsa"

PLATFORM_VENDOR = "accton"
BISDN_ONIE_MACHINE = "as4630-54pe"

ONIE_VENDOR = "accton"
ONIE_MACHINE_TYPE = "as4630_54pe"

ONL_PLATFORM_SUPPORT = " \
    x86_64-accton_as4630_54pe-r0 \
    x86_64-accton_as4630_54te-r0 \
"

GLIBC_ADDONS = "nptl"

MACHINE_EXTRA_RDEPENDS += " \
    accton-as4630-54pe-poe-mcu-mod \
    kernel-module-optoe \
    kernel-module-x86-64-accton-as4630-54pe-cpld \
    kernel-module-x86-64-accton-as4630-54pe-leds \
    kernel-module-x86-64-accton-as4630-54pe-psu \
    kernel-module-x86-64-accton-as4630-54te-cpld \
    kernel-module-x86-64-accton-as4630-54te-leds \
    kernel-module-x86-64-accton-as4630-54te-psu \
    kernel-module-ym2651y \
"
MACHINE_EXTRA_RDEPENDS += "platform-as4630-54pe"

OFDPA_SWITCH_SUPPORT = "BCM56370"
```

## conf/machine/accton-as5835-54x.conf
```bitbake
#@TYPE: Machine
#@NAME: accton-as5835-54x

#@DESCRIPTION: Machine configuration for accton-as5835-54x systems

PREFERRED_PROVIDER_virtual/kernel ?= "linux-yocto-onl"
PREFERRED_VERSION_linux-yocto-onl ?= "5.15%"

KMACHINE:accton-as5835-54x = "x86_64-intel"
KERNEL_FEATURES += "bsp/x86_64-intel"

DEFAULTTUNE ?= "corei7-64"

require conf/machine/include/x86/tune-corei7.inc
require conf/machine/include/x86/x86-base.inc
require conf/machine/include/onl.inc

MACHINE_FEATURES += "pcbios efi"
MACHINE_FEATURES:remove = "alsa"

SYSLINUX_OPTS = "serial 1 115200"
SERIAL_CONSOLE = "115200 ttyS0"
APPEND += "console=ttyS0,115200 console=tty0"

PLATFORM_VENDOR = "accton"
BISDN_ONIE_MACHINE = "as5835-54x"

ONIE_VENDOR = "accton"
ONIE_MACHINE_TYPE = "as5835-54x"

GLIBC_ADDONS = "nptl"

MACHINE_EXTRA_RDEPENDS += " \
    kernel-module-optoe \
    kernel-module-x86-64-accton-as5835-54x-cpld \
    kernel-module-x86-64-accton-as5835-54x-fan \
    kernel-module-x86-64-accton-as5835-54x-leds \
    kernel-module-x86-64-accton-as5835-54x-psu \
    kernel-module-ym2651y \
"
MACHINE_EXTRA_RDEPENDS += "platform-${ONIE_MACHINE_TYPE}"

# FIXME BCM56771 according to datasheet
OFDPA_SWITCH_SUPPORT = "BCM56770"
```

## conf/machine/accton-as7726-32x.conf
```bitbake
#@TYPE: Machine
#@NAME: accton-as7726-32x

#@DESCRIPTION: Machine configuration for accton-as7726-32x systems

PREFERRED_PROVIDER_virtual/kernel ?= "linux-yocto-onl"
PREFERRED_VERSION_linux-yocto-onl ?= "6.1%"

KMACHINE:accton-as7726-32x = "x86_64-intel"
KERNEL_FEATURES += "bsp/x86_64-intel"

DEFAULTTUNE ?= "corei7-64"

require conf/machine/include/x86/tune-corei7.inc
require conf/machine/include/x86/x86-base.inc
require conf/machine/include/onl.inc

MACHINE_FEATURES += "pcbios efi"
MACHINE_FEATURES:remove = "alsa"

ONIE_VENDOR = "accton"
ONIE_MACHINE_TYPE = "as7726_32x"

MACHINE_EXTRA_RDEPENDS += " \
    kernel-module-optoe \
    kernel-module-x86-64-accton-as7726-32x-cpld \
    kernel-module-x86-64-accton-as7726-32x-fan \
    kernel-module-x86-64-accton-as7726-32x-leds \
    kernel-module-x86-64-accton-as7726-32x-psu \
    kernel-module-ym2651y \
    platform-onl-init \
"

OFDPA_SWITCH_SUPPORT = "BCM56870"
```

## conf/machine/accton-csp7551.conf
```bitbake
#@TYPE: Machine
#@NAME: accton-csp7551

#@DESCRIPTION: Machine configuration for accton-csp7551 systems

PREFERRED_PROVIDER_virtual/kernel ?= "linux-yocto-onl"
PREFERRED_VERSION_linux-yocto-onl ?= "5.15%"

KMACHINE:accton-csp7551 = "x86_64-intel"
KERNEL_FEATURES += "bsp/x86_64-intel"

DEFAULTTUNE ?= "corei7-64"

# https://git.yoctoproject.org/poky/tree/meta/conf/machine/include?h=kirkstone
require conf/machine/include/x86/tune-corei7.inc
require conf/machine/include/x86/x86-base.inc

# https://github.com/bisdn/meta-open-network-linux/blob/master/conf/machine/include/onl.inc
require conf/machine/include/onl.inc

# Don't install onlpd/libonlp*
BISDN_SWITCH_IMAGE_EXTRA_INSTALL:remove = "onl"

MACHINE_FEATURES += "pcbios efi"
MACHINE_FEATURES:remove = "alsa"

PLATFORM_VENDOR = "accton"
BISDN_ONIE_MACHINE = "csp7551"

ONIE_VENDOR = "accton"
ONIE_MACHINE_TYPE = "csp7551"

MACHINE_EXTRA_RDEPENDS += " \
    accton-csp7551-cpld-mod \
    accton-csp7551-fpga-mod \
    accton-csp7551-sfp-mod \
"
```

## conf/machine/agema-ag5648.conf
```bitbake
#@TYPE: Machine
#@NAME: agema-ag5648

#@DESCRIPTION: Machine configuration for agema-ag5648 systems

PREFERRED_PROVIDER_virtual/kernel ?= "linux-yocto-onl"
PREFERRED_VERSION_linux-yocto-onl ?= "6.1%"

KMACHINE:agema-ag5648 = "x86_64-intel"
KERNEL_FEATURES += "bsp/x86_64-intel"

DEFAULTTUNE ?= "corei7-64"

require conf/machine/include/x86/tune-corei7.inc
require conf/machine/include/x86/x86-base.inc
require conf/machine/include/onl.inc

MACHINE_FEATURES += "pcbios efi"
MACHINE_FEATURES:remove = "alsa"

PLATFORM_VENDOR = "agema"
BISDN_ONIE_MACHINE = "ag5648"

ONIE_VENDOR = "delta"
ONIE_MACHINE_TYPE = "ag5648"

ONL_PLATFORM_SUPPORT = " \
    x86_64-delta_ag5648-r0 \
    x86_64-delta_ag5648v1-r0 \
"

# delta-ag5648's i2c-cpld is part of delta's common vendor modules
ONL_MODULE_VENDORS = "delta"

MACHINE_EXTRA_RDEPENDS += " \
    platform-onl-init \
    kernel-module-dni-ag5648-psu \
    kernel-module-dni-ag5648-sfp \
    kernel-module-dni-emc2305 \
    kernel-module-i2c-cpld \
"
```

## conf/machine/agema-ag7648.conf
```bitbake
#@TYPE: Machine
#@NAME: agema-ag7648

#@DESCRIPTION: Machine configuration for agema-ag7648 systems

PREFERRED_PROVIDER_virtual/kernel ?= "linux-yocto-onl"
PREFERRED_VERSION_linux-yocto-onl ?= "5.15%"

KMACHINE:agema-ag7648 = "x86_64-intel"
KERNEL_FEATURES += "bsp/x86_64-intel"

DEFAULTTUNE ?= "corei7-64"

require conf/machine/include/x86/tune-corei7.inc
require conf/machine/include/x86/x86-base.inc
require conf/machine/include/onl.inc

MACHINE_FEATURES += "pcbios efi"
MACHINE_FEATURES:remove = "alsa"

SYSLINUX_OPTS = "serial 0 115200"
SERIAL_CONSOLE = "115200 ttyS0"
APPEND += "console=ttyS0,115200"

PLATFORM_VENDOR = "agema"
BISDN_ONIE_MACHINE = "ag7648"

ONIE_VENDOR = "delta"
ONIE_MACHINE_TYPE = "ag7648"

GLIBC_ADDONS = "nptl"

MACHINE_EXTRA_RDEPENDS += "kernel-module-x86-64-delta-ag7648-cpld-mux-1"
MACHINE_EXTRA_RDEPENDS += "kernel-module-x86-64-delta-ag7648-cpld-mux-2"
MACHINE_EXTRA_RDEPENDS += "kernel-module-x86-64-delta-ag7648-i2c-mux-setting"
MACHINE_EXTRA_RDEPENDS += "platform-${ONIE_MACHINE_TYPE}"
```

## conf/machine/cel-questone-2a.conf
```bitbake
#@TYPE: Machine
#@NAME: agema-ag5648

#@DESCRIPTION: Machine configuration for agema-ag5648 systems

PREFERRED_PROVIDER_virtual/kernel ?= "linux-yocto-onl"
PREFERRED_VERSION_linux-yocto-onl ?= "6.1%"

KMACHINE:cel-questone-2a = "x86_64-intel"
KERNEL_FEATURES += "bsp/x86_64-intel"

DEFAULTTUNE ?= "corei7-64"

require conf/machine/include/x86/tune-corei7.inc
require conf/machine/include/x86/x86-base.inc
require conf/machine/include/onl.inc

MACHINE_FEATURES += "pcbios efi"
MACHINE_FEATURES:remove = "alsa"

PLATFORM_VENDOR = "celestica"
BISDN_ONIE_MACHINE = "questone-2a"

ONIE_VENDOR = "celestica"
ONIE_VENDOR_SHORT = "cel"
ONIE_MACHINE_TYPE = "questone_2a"

MACHINE_EXTRA_RDEPENDS += " \
    ipmitool \
    kernel-module-questone2a-baseboard-cpld \
    kernel-module-questone2a-switchboard \
    kernel-module-optoe \
    kernel-module-mc24lc64t \
    platform-onl-init \
"

OFDPA_SWITCH_SUPPORT = "BCM56770"
```

## conf/machine/delta-tn48m.conf
```bitbake
#@TYPE: Machine
#@NAME: delta-tn48m

#@DESCRIPTION: Machine configuration for delta-tn48m systems

PREFERRED_PROVIDER_virtual/kernel ?= "linux-yocto-switchdev"
PREFERRED_VERSION_linux-yocto-onl ?= "5.15%"

KMACHINE:delta-tn48m = "arm64-all"
KERNEL_FEATURES += "bsp/arm64-all"

DEFAULTTUNE ?= "cortexa72"

# https://git.yoctoproject.org/poky/tree/meta/conf/machine/include?h=kirkstone
require conf/machine/include/qemu.inc
require conf/machine/include/arm/armv8a/tune-cortexa72.inc

# https://github.com/bisdn/meta-open-network-linux/blob/master/conf/machine/include/onl.inc
require conf/machine/include/onl.inc

BISDN_SWITCH_IMAGE_EXTRA_INSTALL:remove = "onl"
BISDN_SWITCH_IMAGE_EXTRA_INSTALL:append = " onl-dentos"

MACHINE_FEATURES += "pcbios"
MACHINE_FEATURES:remove = "alsa"

KERNEL_FEATURES:remove = "features/debug/printk.scc features/kernel-sample/kernel-sample.scc"

# https://git.yoctoproject.org/poky/tree/meta/classes/kernel-fitimage.bbclass
KERNEL_CLASSES += "kernel-fitimage"

KERNEL_IMAGETYPE = "fitImage"
UBOOT_ENTRYPOINT="0x80080000"
UBOOT_RD_LOADADDRESS = "0x00000000"
UBOOT_RD_ENTRYPOINT = "0x00000000"
UBOOT_DTB_LOADADDRESS = "0x90000000"
KERNEL_EXTRA_ARGS += "LOADADDR=${UBOOT_ENTRYPOINT}"
KERNEL_DEVICETREE = "marvell/delta-tn48m.dtb marvell/delta-tn48m-dn.dtb"
PLATFORM_VENDOR = "delta"
BISDN_ONIE_MACHINE = "tn48m"
BISDN_ARCH = "u-boot-arch"

ONIE_VENDOR = "delta"
ONIE_MACHINE_TYPE = "tn48m"

# Linux kernel modules
MACHINE_EXTRA_RDEPENDS += " \
    kernel-module-arm64-delta-tn48m-cpld \
    kernel-module-arm64-delta-tn48m-led \
    kernel-module-arm64-delta-tn48m-dn-cpld \
    kernel-module-arm64-delta-tn48m-dn-led \
"

# Firmware needed by prestera kernel module
MACHINE_EXTRA_RDEPENDS += "marvell-prestera-firmware"

# Code to load and configure kernel modules
MACHINE_EXTRA_RDEPENDS += "platform-tn48m"

UBOOT_CONFIG = "sandbox"
UBOOT_CONFIG[sandbox] = "sandbox_defconfig"

PREFERRED_RPROVIDER_u-boot-default-env = "platform-tn48m"
```

## conf/machine/generic-armel-iproc.conf
```bitbake
#@TYPE: Machine
#@NAME: generic armel iProc ONL image

#@DESCRIPTION: Machine configuration for generic armel iProc ONL image

PREFERRED_PROVIDER_virtual/kernel ?= "linux-yocto-onl"
PREFERRED_VERSION_linux-yocto-onl ?= "6.12%"

KMACHINE:generic-armel-iproc = "armel-iproc"
KERNEL_FEATURES += "bsp/armel-iproc"

DEFAULTTUNE ?= "cortexa9"
require conf/machine/include/qemu.inc
require conf/machine/include/arm/armv7a/tune-cortexa9.inc
require conf/machine/include/onl.inc

MACHINE_FEATURES += "pcbios"
MACHINE_FEATURES:remove = "alsa"

KERNEL_FEATURES:remove = "features/debug/printk.scc features/kernel-sample/kernel-sample.scc features/taskstats/taskstats.scc"

# https://git.yoctoproject.org/poky/tree/meta/classes/kernel-fit-extra-artifacts.bbclass
KERNEL_CLASSES += "kernel-fit-extra-artifacts"

# KERNEL_IMAGETYPE = "fitImage"
UBOOT_ENTRYPOINT = "0x61008000"
UBOOT_RD_LOADADDRESS = "0x00000000"
UBOOT_RD_ENTRYPOINT = "0x00000000"
# AS4610 U-Boot does not support sha256
FIT_HASH_ALG = "sha1"
KERNEL_EXTRA_ARGS += "LOADADDR=${UBOOT_ENTRYPOINT}"

PREFERRED_PROVIDER_virtual/dtb = "generic-armel-iproc-dtbs"

BISDN_ARCH = "u-boot-arch"

ONL_PLATFORM_SUPPORT = " \
    arm-accton_as4610_30-r0 \
    arm-accton_as4610_54-r0 \
"

# Do not install the kernel image package
RRECOMMENDS:${KERNEL_PACKAGE_NAME}-base = ""
# Install the FIT image package
MACHINE_ESSENTIAL_EXTRA_RDEPENDS += "linux-yocto-fitimage"

# Configure the image.bbclass to depend on the FIT image instead of only
# the kernel to ensure the FIT image is built and deployed with the image
KERNEL_DEPLOY_DEPEND = "linux-yocto-fitimage:do_deploy"

MACHINE_EXTRA_RDEPENDS += " \
    bcm591xx-poe-mcu-mod \
    packagegroup-onl-platform-arm-accton-as4610 \
    platform-onl-init \
"

UBOOT_CONFIG = "sandbox"
UBOOT_CONFIG[sandbox] = "sandbox_defconfig"

PREFERRED_RPROVIDER_u-boot-default-env = "platform-onl-init"
```

## conf/machine/generic-x86-64.conf
```bitbake
#@TYPE: Machine
#@NAME: generic x86-64 ONL image

#@DESCRIPTION: Machine configuration for generic x86-64 ONL image

PREFERRED_PROVIDER_virtual/kernel ?= "linux-yocto-onl"
PREFERRED_VERSION_linux-yocto-onl ?= "6.6%"

KMACHINE:generic-x86-64 = "x86_64-intel"
KERNEL_FEATURES += "bsp/x86_64-intel"

DEFAULTTUNE ?= "corei7-64"

require conf/machine/include/x86/tune-corei7.inc
require conf/machine/include/x86/x86-base.inc
require conf/machine/include/onl.inc

MACHINE_FEATURES += "pcbios efi"
MACHINE_FEATURES:remove = "alsa"

ONL_PLATFORM_SUPPORT = " \
    x86_64-accton_as4630_54pe-r0 \
    x86_64-accton_as4630_54te-r0 \
    x86_64-accton_as7726_32x-r0 \
    x86_64-accton_as5835_54x-r0 \
    x86_64-delta_ag5648-r0 \
    x86_64-delta_ag5648v1-r0 \
    x86_64-delta_ag7648-r0 \
    x86_64-cel_questone_2a-r0 \
"

MACHINE_EXTRA_RDEPENDS += " \
    bcm591xx-poe-mcu-mod \
    packagegroup-onl-platform-x86-64-accton-as4630-54pe \
    packagegroup-onl-platform-x86-64-accton-as4630-54te \
    packagegroup-onl-platform-x86-64-accton-as5835-54x \
    packagegroup-onl-platform-x86-64-accton-as7726-32x \
    packagegroup-onl-platform-x86-64-cel-questone-2a \
    packagegroup-onl-platform-x86-64-delta-ag5648 \
    packagegroup-onl-platform-x86-64-delta-ag7648 \
    platform-onl-init \
"
```

## conf/machine/include/onl.inc
```bitbake
# onie vars
ONIE_VENDOR ?= "unknown"
# TODO setup a mapping?
ONIE_VENDOR_SHORT ?= "${ONIE_VENDOR}"
ONIE_MACHINE_TYPE ?= "unknown"
ONIE_ARCH ?= "${TARGET_ARCH}"
ONIE_MACHINE ?= "${ONIE_VENDOR_SHORT}_${ONIE_MACHINE_TYPE}"
ONIE_MACHINE_REV ?= "0"
ONIE_PLATFORM ?= "${ONIE_ARCH}-${ONIE_MACHINE}-r${ONIE_MACHINE_REV}"

# onl vars
ONL_PLATFORM="${@'${ONIE_ARCH}-${ONIE_MACHINE}'.replace('_', '-')}"

# list of platforms in ONIE format for which to include support
ONL_PLATFORM_SUPPORT ?= "${ONIE_PLATFORM}"

# some platforms require common vendor modules
ONL_MODULE_VENDORS ?= ""
```
